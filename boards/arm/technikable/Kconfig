## boards/arm/technikable/Kconfig
```kconfig
# SPDX-License-Identifier: MIT

config BOARD_ENABLE_DCDC
	bool "Enable DCDC mode"
	select SOC_DCDC_NRF52X
	default y
	depends on BOARD_TECHNIKABLE

CONFIG_ZMK_SLEEP=y
CONFIG_ZMK_IDLE_TIMEOUT=10000
CONFIG_ZMK_IDLE_SLEEP_TIMEOUT=600000
```

## west.yml
```yaml
manifest:
  remotes:
    - name: forsongen
      url-base: https://github.com/forsongen
  projects:
    - name: zmk
      remote: forsongen
      revision: technikable
      import: app/west.yml
  self:
    path: config
```
